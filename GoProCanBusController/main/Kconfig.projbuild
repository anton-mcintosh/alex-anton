## GoProCanBusController/main/Kconfig.projbuild
```kconfig
menu "Configuration"

    config ESP_WIFI_SSID
        string "WiFi SSID"
        default "HERO-RC-000000"
        help
            SSID (network name) for the example to connect to.

    config ESP_WIFI_PASSWORD
        string "WiFi Password"
        default ""
        help
            WiFi password (WPA or WPA2) for the example to use.
    config ESP_WIFI_CHANNEL
        int "WiFi Channel"
        range 1 13
        default 1
        help
            WiFi channel (network channel) for the example to use.

    config ESP_MAX_STA_CONN
        int "Maximal STA connections"
        default 4
        help
            Max number of the STA connects to AP.
    config STATIC_IP_ADDR
        string "Acces Point IP"
        default "10.71.79.1"
        help
            IP address of the Soft AP.
    config STATIC_NETMASK_ADDR
        string "Network Mask"
        default "255.255.255.0"
        help
            IP address of the Soft AP.
    config STATIC_GW_ADDR  
        string "Gateway Address"
        default "10.71.79.1"
        help
            IP address of the Soft AP Gateway.
    config HTTPD_MAX_REQ_HDR_LEN  
        int "Max HTTPS Gateway Header Length"
        default 1024
        help
            This sets the maximum supported size of headers section in HTTP request packet to be processed by the server
endmenu
```

## GoProCanBusController/sdkconfig.defaults
```kconfig
CONFIG_PARTITION_TABLE_CUSTOM=y
CONFIG_PARTITION_TABLE_CUSTOM_FILENAME="partitions.csv"
CONFIG_PARTITION_TABLE_FILENAME="partitions.csv"
CONFIG_ESPTOOLPY_FLASHSIZE_8MB=y
CONFIG_ESPTOOLPY_FLASHSIZE="8MB"

# Needed for the HTTP posting
CONFIG_HTTPD_MAX_REQ_HDR_LEN=1024

# BT config
CONFIG_BT_ENABLED=y
CONFIG_BTDM_CTRL_MODE_BLE_ONLY=y
CONFIG_BTDM_CTRL_MODE_BR_EDR_ONLY=n
CONFIG_BTDM_CTRL_MODE_BTDM=n
CONFIG_BT_BLUEDROID_ENABLED=n
CONFIG_BT_NIMBLE_ENABLED=y
CONFIG_BT_NIMBLE_NVS_PERSIST=y
CONFIG_BT_NIMBLE_MSYS_1_BLOCK_COUNT=16 # increase the MBUF sizes
CONFIG_BT_NIMBLE_MSYS_2_BLOCK_COUNT=32 # increase the MBUF sizes
```
